# ET6801 register map
Vendor: ETMCU Inc.; File version: v0.0.1
ET6801 ARM 32-bit Cortex-M7 Microcontroller based device
CPU: CM7 r2p1, little endian, MPU, FPU, I-cache, D-cache, ITCM, DTCM, 4 interrupt priority bits
Registers are 32-bit, read-write, reset 0x0 unless marked. A register's access mark holds for its fields unless they carry their own. Offsets are from the block's base; lines under a group give offsets from that group; [hi:lo] are bit positions; {n}, {i} and the like mark numbered series; 'fields as' and 'values as' point back to an identical list; <NAME> marks a mode.

## Memory map
0x40000000 SRPWMCOM size 0x1000 — Provide an overview of the purpose and functionality of the peripheral: epwmcom_cfg
0x40002000 SRPWM0 size 0x1000 — Provide an overview of the purpose and functionality of the peripheral: epwm_cfg
{0x40002000+0x1000*n} SRPWM{n} size 0x1000 (n=1..17)
0x40020000 XBAR size 0x1000 — Provide an overview of the purpose and functionality of the peripheral: xbar
0x40022000 CLB size 0x1000 — Provide an overview of the purpose and functionality of the peripheral: clb
0x40024000 ETIMER size 0x1000 — Provide an overview of the purpose and functionality of the peripheral: etim_cfg
0x40100000 DAC0 size 0x1000 — Provide an overview of the purpose and functionality of the peripheral: dacc_cfg
0x40101000 DAC1 size 0x1000
0x40103000 WAG size 0x1000 — Provide an overview of the purpose and functionality of the peripheral: wag_cfg
0x40104000 ACMP0 size 0x1000 — Provide an overview of the purpose and functionality of the peripheral: cmpc_cfg
{0x40104000+0x1000*n} ACMP{n} size 0x1000 (n=1..10)
0x4010F000 QEP0 size 0x1000 — Provide an overview of the purpose and functionality of the peripheral: qep
0x40110000 QEP1 size 0x1000
0x40111000 QEP2 size 0x1000
0x40112000 QEP3 size 0x1000
0x40113000 QEP4 size 0x1000
0x40114000 QEP5 size 0x1000
0x40115000 SDFM0 size 0x1000 — Provide an overview of the purpose and functionality of the peripheral: sdfm_cfg
0x40116000 SDFM1 size 0x1000
0x40117000 SDFM2 size 0x1000
0x40118000 SDFM3 size 0x1000
0x40119000 ADC0 size 0x1000 — Provide an overview of the purpose and functionality of the peripheral: sarc_cfg
0x4011A000 ADC1 size 0x1000
0x4011B000 ADC2 size 0x1000
0x40200000 AHBDMA0 size 0x1000 — Provide an overview of the purpose and functionality of the peripheral: hdmac_cfg
0x40201000 AHBDMA1 size 0x1000
0x40204000 FMAC size 0x1000 — Provide an overview of the purpose and functionality of the peripheral: fmac_cfg
0x40205000 AES size 0x1000 — Provide an overview of the purpose and functionality of the peripheral: aes_cfg
0x40206000 CRC size 0x1000 — Provide an overview of the purpose and functionality of the peripheral: crc_cfg
0x40208000 IPCM size 0x1000 — Provide an overview of the purpose and functionality of the peripheral: ipcm_cfg
0x40209000 SPINLOCK size 0x1000 — Provide an overview of the purpose and functionality of the peripheral: spinlock_cfg
0x4020A000 QSPI size 0x1000 — Provide an overview of the purpose and functionality of the peripheral: QSPI_DWC_ssi
0x40210000 GPIOA size 0x1000 — Provide an overview of the purpose and functionality of the peripheral: gpio_cfg
0x40211000 GPIOB size 0x1000
0x40212000 GPIOC size 0x1000
0x40213000 GPIOD size 0x1000
0x40214000 GPIOE size 0x1000
0x40215000 GPIOF size 0x1000
0x40216000 GPIOG size 0x1000
0x40217000 GPIOH size 0x1000
0x40218000 GPIOI size 0x1000
0x40400000 SYSC size 0x1000 — Provide an overview of the purpose and functionality of the peripheral: sysc
0x40402000 WDG0 size 0x1000 — Provide an overview of the purpose and functionality of the peripheral: wwdg
0x40403000 WDG1 size 0x1000
0x40406000 STIMER0 size 0x1000 — Provide an overview of the purpose and functionality of the peripheral: stm_cfg
0x40407000 STIMER1 size 0x1000
0x40408000 STIMER2 size 0x1000
0x40409000 STIMER3 size 0x1000
0x4040A000 STIMER4 size 0x1000
0x4040B000 STIMER5 size 0x1000
0x4040C000 CRG size 0x1000 — Provide an overview of the purpose and functionality of the peripheral: crg_cfg
0x4040D000 SYSCNT_RO size 0x8 — Provide an overview of the purpose and functionality of the peripheral: SYSCNT_RO
0x4040E000 SYSCNT_CTRL size 0x24 — Provide an overview of the purpose and functionality of the peripheral: SYSCNT_CTRL
0x4040F000 IOMUX size 0x1000 — Provide an overview of the purpose and functionality of the peripheral: ioc
0x40500000 UART0 size 0x1000 — Provide an overview of the purpose and functionality of the peripheral: UART
0x40501000 UART1 size 0x1000
0x40502000 UART2 size 0x1000
0x40503000 UART3 size 0x1000
0x40504000 UART4 size 0x1000
0x40505000 UART5 size 0x1000
0x40506000 UART6 size 0x1000
0x40507000 UART7 size 0x1000
0x40508000 I2C0 size 0x151 — Provide an overview of the purpose and functionality of the peripheral: I2C
0x40509000 I2C1 size 0x151
0x4050A000 I2C2 size 0x151
0x4050B000 SPI0 size 0x1000 — Provide an overview of the purpose and functionality of the peripheral: SPI_DWC_ssi
0x4050C000 SPI1 size 0x1000
0x4050D000 SPI2 size 0x1000
0x4050E000 SPI3 size 0x1000
0x40510000 LIN0 size 0x1000 — Provide an overview of the purpose and functionality of the peripheral: lin
0x40511000 LIN1 size 0x1000
0x40518000 CAN0 size 0x1000 — Provide an overview of the purpose and functionality of the peripheral: mttcan_cfg
0x40518800 CAN_MISC0 size 0x1000 — Provide an overview of the purpose and functionality of the peripheral: mttcan_misc
0x40520000 CAN1 size 0x1000
0x40520800 CAN_MISC1 size 0x1000
0x40528000 CAN2 size 0x1000
0x40528800 CAN_MISC2 size 0x1000
0x40600000 CPU0 size 0x1000 — Provide an overview of the purpose and functionality of the peripheral: m7_cfg
0x40601000 CPU1 size 0x1000
0x40603000 PFLASH size 0x1000 — Provide an overview of the purpose and functionality of the peripheral: efc_cfg_pflash
0x40604000 DFLASH size 0x1000 — Provide an overview of the purpose and functionality of the peripheral: efc_cfg_dflash
0x40605000 EMIF0 size 0x1000 — Provide an overview of the purpose and functionality of the peripheral: emif_0
0x40606000 EMIF1 size 0x1000 — Provide an overview of the purpose and functionality of the peripheral: smc_cfg_ids
0x40608000 SRAMCTL0 size 0x1000 — Provide an overview of the purpose and functionality of the peripheral: axi2sram
0x40609000 SRAMCTL1 size 0x1000
0x50000000 CORDIC size 0x1000 — Provide an overview of the purpose and functionality of the peripheral: cordic_cfg
0x50001000 ADCREG size 0x1000 — Provide an overview of the purpose and functionality of the peripheral: adcreg
0xE000E008 SCB_ACTRL size 0x5 — System control block ACTLR
0xE000E010 SYSTICK size 0x11 — SysTick timer
0xE000E100 NVIC size 0x400 — Nested Vectored Interrupt Controller
0xE000ED00 SCB size 0x41 — System control block
0xE000ED78 PF size 0xD — Processor features
0xE000ED88 FPU_CPACR size 0x5 — Floating point unit CPACR
0xE000ED90 MPU size 0x15 — Memory protection unit
0xE000EF00 NVIC_STIR size 0x5 — Nested vectored interrupt controller
0xE000EF34 FPU size 0xD — Floting point unit

## Interrupts
2 FMAC
3 AES
4 CRC
5 CORDIC
6 DMA0_TFR (AHBDMA0)
7 DMA0_BLOCK (AHBDMA0)
8 DMA0_SRCTRAN (AHBDMA0)
9 DMA0_DSTTRAN (AHBDMA0)
10 DMA0_ERROR (AHBDMA0)
11 DMA0_COMBINED (AHBDMA0)
12 DMA1_TFR (AHBDMA1)
13 DMA1_BLOCK (AHBDMA1)
14 DMA1_SRCTRAN (AHBDMA1)
15 DMA1_DSTTRAN (AHBDMA1)
16 DMA1_ERROR (AHBDMA1)
17 DMA1_COMBINED (AHBDMA1)
18 WDG0
19 WDG1
20 LIN0_FUNC (LIN0)
21 LIN0_ERR (LIN0)
22 LIN1_FUNC (LIN1)
23 LIN1_ERR (LIN1)
{n+24} UART{n} (n=0..7)
32 I2C0
33 I2C1
34 I2C2
35 SPI0
36 SPI1
37 SPI2
38 SPI3
39 CAN0_INT0 (CAN0)
40 CAN0_INT1 (CAN0)
41 CAN0_DMU (CAN0)
42 CAN1_INT0 (CAN1)
43 CAN1_INT1 (CAN1)
44 CAN1_DMU (CAN1)
45 CAN2_INT0 (CAN2)
46 CAN2_INT1 (CAN2)
47 CAN2_DMU (CAN2)
48 CAN_ECC (CAN2)
{n+49} IPCM{n} (IPCM) (n=0..15)
65 GPIOA_COMBINT (GPIOA)
66 GPIOB_COMBINT (GPIOB)
67 GPIOC_COMBINT (GPIOC)
68 GPIOD_COMBINT (GPIOD)
69 GPIOE_COMBINT (GPIOE)
70 GPIOF_COMBINT (GPIOF)
71 GPIOG_COMBINT (GPIOG)
72 GPIOH_COMBINT (GPIOH)
73 GPIOI_COMBINT (GPIOI)
74 PBUS1_TIMEOUT (SYSC)
75 PBUS2_TIMEOUT (SYSC)
76 HBUS1_TIMEOUT (SYSC)
77 HBUS2_TIMEOUT (SYSC)
78 HBUS3_TIMEOUT (SYSC)
{n+79} GPIOE_{n} (GPIOE) (n=0..15)
95 EFC1 (PFLASH)
96 EFC2 (DFLASH)
97 PBUS3_TIMEOUT (SYSC)
98 QSPI
99 SRAM0_ECC_SERR (SRAMCTL0)
100 SRAM0_ECC_MERR (SRAMCTL0)
101 SRAM1_ECC_SERR (SRAMCTL1)
102 SRAM1_ECC_MERR (SRAMCTL1)
103 CORE2PERI_TIMEOUT (CPU0)
104 PERI2CORE_TIMEOUT (CPU0)
105 CPU0_MISC (CPU0)
106 CPU1_MISC (CPU1)
{n+107} ACMP{n} (n=0..10)
118 DAC0
119 DAC1
120 ADC0_EVTINT (ADC0)
121 ADC0_INT01 (ADC0)
122 ADC0_INT (ADC0)
123 ADC0_INT2 (ADC0)
124 ADC0_INT3 (ADC0)
125 ADC1_EVTINT (ADC1)
126 ADC1_INT0 (ADC1)
127 ADC1_INT1 (ADC1)
128 ADC1_INT2 (ADC1)
129 ADC1_INT3 (ADC1)
130 ADC2_EVTINT (ADC2)
131 ADC2_INT0 (ADC2)
132 ADC2_INT1 (ADC2)
133 ADC2_INT2 (ADC2)
134 ADC2_INT3 (ADC2)
135 QEP0
136 QEP1
137 QEP2
138 QEP3
139 QEP4
140 QEP5
141 SDFM0_ERR (SDFM0)
142 SDFM0_DR0 (SDFM0)
143 SDFM0_DR1 (SDFM0)
144 SDFM0_DR2 (SDFM0)
145 SDFM0_DR3 (SDFM0)
146 SDFM1_ERR (SDFM1)
147 SDFM1_DR0 (SDFM1)
148 SDFM1_DR1 (SDFM1)
149 SDFM1_DR2 (SDFM1)
150 SDFM1_DR3 (SDFM1)
151 SDFM2_ERR (SDFM2)
152 SDFM2_DR0 (SDFM2)
153 SDFM2_DR1 (SDFM2)
154 SDFM2_DR2 (SDFM2)
155 SDFM2_DR3 (SDFM2)
156 SDFM3_ERR (SDFM3)
157 SDFM3_DR0 (SDFM3)
158 SDFM3_DR1 (SDFM3)
159 SDFM3_DR2 (SDFM3)
160 SDFM3_DR3 (SDFM3)
161 STIMER0
162 STIMER1
163 STIMER2
164 STIMER3
165 STIMER4
166 STIMER5
{n+167} ETIMER{n} (ETIMER) (n=0..11)
{n+179} SRPWM{n} (n=0..17)
197 SYSC
198 CORE2CORE (SYSC)
199 XBAR_INT0 (XBAR)
200 XBAR_INT1 (XBAR)
201 XBAR_INT2 (XBAR)
202 XBAR_INT3 (XBAR)
203 XBAR_INT4 (XBAR)
204 XBAR_INT5 (XBAR)
205 CLB_INT0 (CLB)
206 CLB_INT1 (CLB)
207 CLB_INT2 (CLB)
208 CLB_INT3 (CLB)
209 CLB_INT4 (CLB)
210 CLB_INT5 (CLB)
